## config/west.yml
```yaml
manifest:
  defaults:
    revision: v0.3
  remotes:
    - name: zmkfirmware
      url-base: https://github.com/zmkfirmware
    - name: mArcio-Lmano                         #new entry
      url-base: https://github.com/mArcio-Lmano  #new entry
    # Additional modules containing boards/shields/custom code can be listed here as well
    # See https://docs.zephyrproject.org/3.2.0/develop/west/manifest.html#projects
  projects:
    - name: zmk
      remote: zmkfirmware
      import: app/west.yml
    - name: nice_view_module   #new entry
      remote: mArcio-Lmano                       #new entry
      revision: New/animation                     #new entry
  self:
    path: config
```
